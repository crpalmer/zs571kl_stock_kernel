## drivers/input/touchscreen/focal3267/Kconfig
```kconfig
config TOUCHSCREEN_FOCAL_FT3267
tristate "FocalTech FT3267 touchscreen"
       depends on I2C
       help
       ?       Say Y here if you have a FocalTech FT3517 touchscreen
       ?       If unsure, say N.
```

## drivers/usb/Anx7688/Kconfig
```kconfig
config ANALOGIX_OHIO 
	tristate "Analogix Type-C interface support"
	help
        	Analogix type-c interface is a  chip support USB PD protocol device

config OCM_DEBUG_PD
	tristate "type-c debug support"
	help
		Analogix type-c debug log
```
