/* Copyright (c) 2014-2015, The Linux Foundation. All rights reserved.
 *
 * This program is free software; you can redistribute it and/or modify
 * it under the terms of the GNU General Public License version 2 and
 * only version 2 as published by the Free Software Foundation.
 *
 * This program is distributed in the hope that it will be useful,
 * but WITHOUT ANY WARRANTY; without even the implied warranty of
 * MERCHANTABILITY or FITNESS FOR A PARTICULAR PURPOSE.  See the
 * GNU General Public License for more details.
 */

&mdss_mdp {
	dsi_dual_sdc_cmd: qcom,mdss_dsi_sdc_wqxga_cmd {
		qcom,mdss-dsi-panel-name = "SDC WQXGA Command mode dsi panel";
		qcom,mdss-dsi-panel-type = "dsi_cmd_mode";
		qcom,mdss-dsi-panel-framerate = <60>;
		qcom,mdss-dsi-virtual-channel-id = <0>;
		qcom,mdss-dsi-stream = <0>;
		qcom,mdss-dsi-panel-width = <720>;
		qcom,mdss-dsi-panel-height = <2560>;
		qcom,mdss-dsi-h-front-porch = <154>;
		qcom,mdss-dsi-h-back-porch = <68>;
		qcom,mdss-dsi-h-pulse-width = <32>;
		qcom,mdss-dsi-h-sync-skew = <0>;
		qcom,mdss-dsi-v-back-porch = <4>;
		qcom,mdss-dsi-v-front-porch = <16>;
		qcom,mdss-dsi-v-pulse-width = <2>;
		qcom,mdss-dsi-h-left-border = <0>;
		qcom,mdss-dsi-h-right-border = <0>;
		qcom,mdss-dsi-v-top-border = <0>;
		qcom,mdss-dsi-v-bottom-border = <0>;
		qcom,mdss-dsi-bpp = <24>;
		qcom,mdss-dsi-underflow-color = <0xff>;
		qcom,mdss-dsi-border-color = <0>;
		qcom,mdss-dsi-h-sync-pulse = <0>;
		qcom,mdss-dsi-traffic-mode = "non_burst_sync_event";
		qcom,mdss-dsi-tx-eot-append;
		qcom,mdss-dsi-bllp-eof-power-mode;
		qcom,mdss-dsi-bllp-power-mode;
		qcom,mdss-dsi-lane-0-state;
		qcom,mdss-dsi-lane-1-state;
		qcom,mdss-dsi-lane-2-state;
		qcom,mdss-dsi-lane-3-state;
		qcom,mdss-dsi-te-pin-select = <1>;
		qcom,mdss-dsi-te-check-enable;
		qcom,mdss-dsi-te-using-te-pin;
		qcom,mdss-pan-physical-width-dimension = <71>;
		qcom,mdss-pan-physical-height-dimension = <125>;
		qcom,mdss-dsi-lp11-init;
		qcom,mdss-dsi-panel-timings-phy-v2 = [24 1f 08 09 05 03 04 a0
			24 1f 08 09 05 03 04 a0
			24 1f 08 09 05 03 04 a0
			24 1f 08 09 05 03 04 a0
			24 1b 08 09 05 03 04 a0];
		qcom,mdss-dsi-t-clk-post = <0x0d>;
		qcom,mdss-dsi-t-clk-pre = <0x30>;
		qcom,mdss-dsi-dma-trigger = "trigger_sw";
		qcom,mdss-dsi-mdp-trigger = "none";
		qcom,mdss-dsi-bl-pmic-control-type = "bl_ctrl_dcs";
		qcom,dcs-cmd-by-left;
		qcom,mdss-dsi-on-command = [05 01 00 00 00 00 02 00 00
					05 01 00 00 05 00 02 11 00
					29 01 00 00 00 00 03 F0 5A 5A
					15 01 00 00 00 00 02 C4 03
					15 01 00 00 00 00 02 F9 03
					29 01 00 00 00 00 14 C2 00 00 D8 D8 00 80 2B 05 08 0E 07 0B 05 0D 0A 15 13 20 1E
					29 01 00 00 78 00 03 F0 A5 A5
					15 01 00 00 00 00 02 35 00
					15 01 00 00 00 00 02 53 20
					05 01 00 00 00 00 02 29 00];

		qcom,mdss-dsi-on-command-state = "dsi_lp_mode";
		qcom,mdss-dsi-off-command = [05 01 00 00 00 00 02 28 00
				05 01 00 00 78 00 02 10 00];


		qcom,mdss-dsi-alpm-on-command = [29 01 00 00 00 00 03 F0 5A 5A
					29 01 00 00 00 00 06 BB D4 00 39 7F 4C
					15 01 00 00 00 00 02 F7 03
					15 01 00 00 00 00 02 53 23
					29 01 00 00 00 00 03 F0 A5 A5
					05 01 00 00 46 00 02 28 00
					29 01 00 00 00 00 02 53 23
					05 01 00 00 00 00 02 29 00
					29 01 00 00 00 00 03 F0 5A 5A
					15 01 00 00 00 00 02 B0 02
					29 01 00 00 00 00 04 BB 33 7F 7F
					15 01 00 00 00 00 02 F7 03
					29 01 00 00 00 00 03 F0 A5 A5];
/*
		qcom,mdss-dsi-alpm-on-command = [29 01 00 00 00 00 03 F0 5A 5A
					29 01 00 00 00 00 06 BB D4 00 39 7F 4C
					15 01 00 00 00 00 02 F7 03
					15 01 00 00 00 00 02 53 22
					29 01 00 00 00 00 03 F0 A5 A5
					05 01 00 00 46 00 02 28 00
					29 01 00 00 00 00 02 53 22
					05 01 00 00 00 00 02 29 00];
*/
		qcom,mdss-dsi-alpm-off-command = [05 01 00 00 46 00 02 28 00
					29 01 00 00 00 00 02 53 20
					05 01 00 00 00 00 02 29 00];

		qcom,mdss-dsi-alpm-on5-command = [29 01 00 00 00 00 03 F0 5A 5A
					29 01 00 00 00 00 06 BB D4 00 39 7F 4C
					15 01 00 00 00 00 02 F7 03
					15 01 00 00 00 00 02 53 23
					29 01 00 00 00 00 03 F0 A5 A5
					05 01 00 00 46 00 02 28 00
					29 01 00 00 00 00 02 53 23
					05 01 00 00 00 00 02 29 00];

		qcom,mdss-dsi-alpm-change40-command = [29 01 00 00 00 00 03 F0 5A 5A
					15 01 00 00 00 00 02 B0 02
					29 01 00 00 00 00 04 BB 33 7F 7F
					15 01 00 00 00 00 02 F7 03
					29 01 00 00 00 00 03 F0 A5 A5];

		qcom,mdss-dsi-alpm-change5-command = [29 01 00 00 00 00 03 F0 5A 5A
					15 01 00 00 00 00 02 B0 02
					29 01 00 00 00 00 04 BB 39 7F 4C
					15 01 00 00 00 00 02 F7 03
					29 01 00 00 00 00 03 F0 A5 A5];

		qcom,mdss-dsi-lp-mode-on = [05 01 00 00 00 00 02 00 00
					15 01 00 00 00 00 02 51 FF
					15 01 00 00 00 00 02 53 20
					29 01 00 00 00 00 03 F0 5A 5A
					15 01 00 00 00 00 02 B0 0E
					29 01 00 00 00 00 03 CB 02 0D
					15 01 00 00 00 00 02 B0 17
					15 01 00 00 00 00 02 CB 14
					15 01 00 00 00 00 02 B0 2D
					15 01 00 00 00 00 02 CB CD
					15 01 00 00 00 00 02 B0 08
					29 01 00 00 00 00 03 B1 10 02
					15 01 00 00 00 00 02 B0 0D
					15 01 00 00 00 00 02 B1 00
					15 01 00 00 00 00 02 F7 03
					29 01 00 00 00 00 03 F0 A5 A5];

		qcom,mdss-dsi-lp-mode-off = [05 01 00 00 00 00 02 00 00
					29 01 00 00 00 00 03 F0 5A 5A
					15 01 00 00 00 00 02 B0 0E
					29 01 00 00 00 00 03 CB 0A 05
					15 01 00 00 00 00 02 B0 17
					15 01 00 00 00 00 02 CB 08
					15 01 00 00 00 00 02 B0 2D
					15 01 00 00 00 00 02 CB 4D
					15 01 00 00 00 00 02 B0 08
					29 01 00 00 00 00 03 B1 00 30
					15 01 00 00 00 00 02 B0 0D
					15 01 00 00 00 00 02 B1 80
					15 01 00 00 00 00 02 F7 03
					29 01 00 00 00 00 03 F0 A5 A5];

		qcom,mdss-dsi-off-command-state = "dsi_hs_mode";
		qcom,mdss-dsi-reset-sequence = <0 10>, <1 5>;
		qcom,mdss-dsi-panel-clockrate = <1112830000>;
		qcom,config-select = <&dsi_sdc_wqxga_cmd_config0>;

		dsi_sdc_wqxga_cmd_config0: config0 {
			qcom,split-mode = "dualctl-split";
		};

		dsi_sdc_wqxga_cmd_config1: config1 {
			qcom,split-mode = "pingpong-split";
		};
	};
};
