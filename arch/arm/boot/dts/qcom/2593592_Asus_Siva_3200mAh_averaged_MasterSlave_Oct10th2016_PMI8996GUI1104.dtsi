
qcom,2593592_asus_siva_3200mah_averaged_masterslave_oct10th2016 {
	/* #2593592_Asus_Siva_3200mAh_averaged_MasterSlave_Oct10th2016*/
	qcom,max-voltage-uv = <4380000>;
	qcom,nom-batt-capacity-mah = <3200>;
	qcom,batt-id-kohm = <51>;
	qcom,battery-beta = <3435>;
	qcom,battery-type = "2593592_asus_siva_3200mah_averaged_masterslave_oct10th2016";
	qcom,chg-rslow-comp-c1 = <2451120>;
	qcom,chg-rslow-comp-c2 = <2807364>;
	qcom,chg-rs-to-rslow = <1191620>;
	qcom,chg-rslow-comp-thr = <0x99>;
	qcom,checksum = <0x9660>;
	qcom,gui-version = "PMI8996GUI - 1.1.0.4";
	qcom,fg-profile-data = [
		 E8 83 1A 7D 
		 3D 81 A1 77 
		 79 83 E0 7C 
		 0F 90 07 96 
		 40 82 45 98 
		 6D B5 9C C0 
		 59 1A 0E 88 
		 90 7E 42 82 
		 C1 7C 60 83 
		 5E 65 47 83 
		 18 8E 49 82 
		 FA 98 76 B7 
		 77 C3 5E 16 
		 41 0C D0 59 
		 91 6F E7 FB 
		 60 3C 45 46 
		 56 3A 00 00 
		 20 4C E5 39 
		 3F 39 00 00 
		 00 00 00 00 
		 00 00 00 00 
		 2D 72 10 71 
		 DF 5E 04 88 
		 A0 76 8B 6A 
		 63 67 4E 79 
		 43 74 4F 61 
		 77 6D 05 A2 
		 2A 0E 61 EB 
		 5D A0 71 0C 
		 28 00 FF 36 
		 F0 11 30 03 
		 00 00 00 0C 
	];
};
